## package/a20-petbot-firmware/Config.in
```kconfig
menuconfig BR2_PACKAGE_A20_PETBOT_FIRMWARE
	bool "a20-petbot-firmware"
	help
	  Basic support for a20 petbot firmware

	  http://www.petbot.com/
```

## package/dragonboard/Config.in
```kconfig
config BR2_PACKAGE_DRAGONBOARD
	bool "dragonboard"
	help
	  Dragonboardutils

	  http://www.xs4all.nl/~carlo17/which/
```

## package/gst-cedarx/Config.in
```kconfig
menuconfig BR2_PACKAGE_GST_CEDARX
	bool "gst-cedarx"
	select BR2_PACKAGE_GST1_PLUGINS_BASE
	select BR2_PACKAGE_MEDIA_CODEC
	help
	  Basic support for gst cedarx

	  http://www.petbot.com/
```

## package/gst-cedrus/Config.in
```kconfig
menuconfig BR2_PACKAGE_GST_CEDRUS
	bool "gst-cedrus"
	select BR2_PACKAGE_GST1_PLUGINS_BASE
	help
	  Basic support for gst cedrus

	  http://www.petbot.com/
```

## package/gst-jpcnn/Config.in
```kconfig
menuconfig BR2_PACKAGE_GST_JPCNN
	bool "gst-jpcnn"
	select BR2_PACKAGE_GST1_PLUGINS_BASE
	select BR2_PACKAGE_LIBJPCNN
	help
	  Basic support for gst jpcnn

	  http://www.petbot.com/
```

## package/gupnp-igd/Config.in
```kconfig
config BR2_PACKAGE_GUPNP_IGD
	bool "gupnp-igd"
	depends on BR2_USE_WCHAR # glib2, gssdp, util-linux
	depends on BR2_TOOLCHAIN_HAS_THREADS # glib2, gssdp
	depends on BR2_USE_MMU # glib2, gssdp
	help
	  GUPnP-igd implements the UPnP specification: resource announcement
	  and discovery, description, control, event notification, and
	  presentation.

	  http://www.gupnp.org/

comment "gupnp-igd needs a toolchain w/ wchar, threads"
	depends on BR2_USE_MMU
	depends on !BR2_USE_WCHAR || !BR2_TOOLCHAIN_HAS_THREADS
```

## package/libjpcnn/Config.in
```kconfig
config BR2_PACKAGE_LIBJPCNN
	bool "libjpcnn"
	help
	  JPCNN library

	  http://jetpac.com
```

## package/media-codec/Config.in
```kconfig
menuconfig BR2_PACKAGE_MEDIA_CODEC
	bool "media-codec"
	help
	  Basic support for media codec

	  http://www.petbot.com/
```
